## conf/distro/attolinux-next.conf
```bitbake
#@--------------------------------------------------------------------
#@TYPE: Distribution
#@NAME: AttoLinux
#@DESCRIPTION: The Linux Distribution for Kernel 2.6 based devices
#@MAINTAINER: Martin Ertsaas <martiert@gmail.com>
#@--------------------------------------------------------------------

# This is a aimed to be the next stable atto release. 
# If you want something stable *right now*, use atto-v2012.05
#
# Again, in doubt, use the master branch of setup-scripts

#DISTRO_VERSION = "v2012.X"
DISTRO_VERSION = "next"

OLDEST_KERNEL = "2.6.16"

require conf/distro/include/sane-srcdates.inc
require conf/distro/include/sane-srcrevs.inc
require conf/distro/include/atto-preferred-versions.inc

#Images built can have to modes:
# 'debug': empty rootpassword, strace included
# 'release' no root password, no strace and gdb by default
DISTRO_TYPE ?= "debug"
#DISTRO_TYPE = "release"

# Set the toolchain type (internal, external) and brand (generic, csl etc.)
TOOLCHAIN_TYPE ?= "internal"
TOOLCHAIN_BRAND ?= ""

# Ship just basic locale by default. Locales are big (~1Mb uncompr.), so
# shipping some adhoc subset will be still useless and size burden for
# users of all other languages/countries. Instead, worth to make it easy
# to install additional languages: installer/wizard + metapackages which
# will RRECOMMEND as much as possible content for a given language
# (locales, UI transalations, help, etc. - useless for pros, but really 
# helpful for common users).
# Also, it appears that no locales fit in 16Mb for now. "C" locale rules!
ROOT_FLASH_SIZE ??= "32"
IMAGE_LINGUAS ?= '${@base_less_or_equal("ROOT_FLASH_SIZE", "16", "", "en-us", d)}'

# set feed path variables
FEED_BASEPATH = "feeds/core/${ATTO_PKG_FORMAT}/${TCLIBC}/"

#This is unrelated to the kernel version, but userspace apps (e.g. udev/systemd) require a recent version to build against
LINUX_LIBC_HEADERS_VERSION ?= "3.10%"
PREFERRED_VERSION_linux-libc-headers = "${LINUX_LIBC_HEADERS_VERSION}"
PREFERRED_VERSION_linux-libc-headers-native = "${LINUX_LIBC_HEADERS_VERSION}"
PREFERRED_VERSION_nativesdk-linux-libc-headers = "${LINUX_LIBC_HEADERS_VERSION}"

# Blackfin has its on gcc
ATTO_GCC_VERSION_bfin			= "4.1.2"

#avr32 only has support for gcc 4.2.2
ATTO_GCC_VERSION_avr32		         ?= "4.2.2"

#Everybody else can just use this: 
ATTO_GCC_VERSION                             ?= "4.8%"

ATTO_BINUTILS_VERSION                        ?= "2.23.2"

PREFERRED_VERSION_binutils                       ?= "${ATTO_BINUTILS_VERSION}"
PREFERRED_VERSION_binutils-cross                 ?= "${ATTO_BINUTILS_VERSION}"
PREFERRED_VERSION_binutils-crosssdk              ?= "${ATTO_BINUTILS_VERSION}"
PREFERRED_VERSION_binutils-native                ?= "${ATTO_BINUTILS_VERSION}"
PREFERRED_VERSION_binutils-cross-canadian-${TRANSLATED_TARGET_ARCH} ?= "${ATTO_BINUTILS_VERSION}"

PREFERRED_VERSION_gcc                            ?= "${ATTO_GCC_VERSION}"
PREFERRED_VERSION_gcc-cross                      ?= "${ATTO_GCC_VERSION}"
PREFERRED_VERSION_gcc-cross-initial              ?= "${ATTO_GCC_VERSION}"
PREFERRED_VERSION_gcc-cross-intermediate         ?= "${ATTO_GCC_VERSION}"
PREFERRED_VERSION_gcc-cross-canadian             ?= "${ATTO_GCC_VERSION}"
PREFERRED_VERSION_gcc-crosssdk                   ?= "${ATTO_GCC_VERSION}"
PREFERRED_VERSION_gcc-crosssdk-initial           ?= "${ATTO_GCC_VERSION}"
PREFERRED_VERSION_gcc-crosssdk-intermediate      ?= "${ATTO_GCC_VERSION}"
PREFERRED_VERSION_gcc-runtime                    ?= "${ATTO_GCC_VERSION}"
PREFERRED_VERSION_nativesdk-gcc-runtime          ?= "${ATTO_GCC_VERSION}"
PREFERRED_VERSION_libgcc                         ?= "${ATTO_GCC_VERSION}"
PREFERRED_VERSION_nativesdk-libgcc               ?= "${ATTO_GCC_VERSION}"
PREFERRED_VERSION_gcc-cross-canadian-${TRANSLATED_TARGET_ARCH} ?= "${ATTO_GCC_VERSION}"

#avr32 only has patches for binutils 2.17 in OE
PREFERRED_VERSION_binutils_avr32 = "2.17"
PREFERRED_VERSION_binutils-cross_avr32 = "2.17"
PREFERRED_VERSION_binutils-cross-sdk_avr32 = "2.17"

PREFERRED_PROVIDER_dbus-glib             = "dbus-glib"
PREFERRED_PROVIDER-gconf-dbus            = "gconf"
PREFERRED_PROVIDER_hotplug               = "systemd"
PREFERRED_PROVIDER_opkg                 ?= "opkg"
PREFERRED_PROVIDER_opkg-native          ?= "opkg-native"

# blacklist policy

PNBLACKLIST[pn-fso-apm]       = "regular apmd is good enough"
PNBLACKLIST[gconf-dbus]        = "gconf-dbus has been merged back into main GConf"
PNBLACKLIST[gconf-dbus-native] = "gconf-dbus has been merged back into main GConf"
PNBLACKLIST[ffmpeg] = "libav is preferred over ffmpeg"

require conf/distro/include/atto.inc

# Toolchain virtuals:
require conf/distro/include/toolchain-${TOOLCHAIN_TYPE}.inc
# Processor specific tunes like hard float ABI
include conf/distro/include/${TARGET_ARCH}-defaults.inc
# Set DISTRO_FEED_CONFIGS to our config var, assigned in the above .inc
DISTRO_FEED_CONFIGS = "${ATTO_FEED_CONFIGS}"

# If we're using an .ipk based rootfs, we want to have opkg installed so postinst script can run
# We also take this opportunity to inject atto-version and the feed configs into the rootfs
IPKG_VARIANT = "opkg atto-version ${ATTO_FEED_CONFIGS}"

# Select xserver-xorg as default, since kdrive has been EOL'ed
XSERVER ?= "xserver-xorg xf86-input-evdev xf86-input-keyboard xf86-input-mouse xf86-video-fbdev"

# do some packagegroup-base stuff here

# Prefer bluez4, it's needed for things like connman. Bluez4 is also largely backward compatible with
# bluez 3.x
DISTRO_BLUETOOTH_MANAGER = "\
	blueprobe \
	bluez4 \
   "

# We want to ship extra debug utils in the rootfs when doing a debug build 
DEBUG_APPS ?= ""
DEBUG_APPS += '${@base_conditional("DISTRO_TYPE", "release", "", "strace procps",d)}'

# This hooks into packagegroup-base, so it won't do anything if your images doesn't include packagegroup-base.
# atto-version: ship this to have an identifiable rootfs so user can report bugs against a specific version
# ATTO_FEED_CONFIGS: configfiles for the online feeds
# util-linux-mount util-linux-umount: busybox mount is broken
# atto-libc-fixup-hack: fixes an obscure bug with libc.so symlink
DISTRO_EXTRA_RDEPENDS += "\
    atto-version \
    ${ATTO_FEED_CONFIGS} \
    util-linux-mount util-linux-umount \
    atto-libc-fixup-hack \
    "

# This also hooks into packagegroup-base, but isn't mandatory.
# If you don't want parts of this in your packagegroup-base using images you can put this in the image recipe:
# BAD_RECOMMENDATIONS = "avahi-daemon avahi-autoipd"
# Note that BAD_RECOMMENDATIONS is a feature of rootfs_ipk.bbclass, not atto
# kernel modules: ship fs modules so you can mount stuff and af-packet so networking works
# avahi: makes finding your device on the network a lot easier
# openssh-sftp-server: provides sftp which combined with avahi makes it real easy to use things like sshfs
# psplash-atto: atto branded psplash, you can add your own psplash-foo to an image, it uses update-alternatives
# DEBUG_APPS: ship strace and procpc to make simple debugging a lot easier
DISTRO_EXTRA_RRECOMMENDS += " \
    kernel-module-vfat \
    kernel-module-ext2 \
    kernel-module-ext3 \
    kernel-module-af-packet \
    avahi-daemon \
    avahi-autoipd \
    openssh-sftp-server \
    ${DEBUG_APPS} \
"

SPLASH ?= ' ${@base_contains("MACHINE_FEATURES", "screen", "psplash-atto", "",d)}'

DISTRO_FEATURES += "${LDISGOLD}"
LDISGOLD_arm = "ld-is-gold"
#LDISGOLD_x86 = "ld-is-gold"
#LDISGOLD_x86_64 = "ld-is-gold"
LDISGOLD ?= ""
```

## conf/distro/include/atto-package-ipk.inc
```bitbake
INHERIT += "package_ipk"

ATTO_FEED_CONFIGS ?= "atto-feed-configs"

EXTRAOPKGCONFIG = "opkg-config-base ${ATTO_FEED_CONFIGS}"

ATTO_IPK_UPDATE_ALTERNATIVES ?= "opkg"

DISTRO_UPDATE_ALTERNATIVES = "${ATTO_IPK_UPDATE_ALTERNATIVES}"

# we need the same provider for opkg and u-a
PREFERRED_PROVIDER_virtual/update-alternatives-native ?= "opkg-native"
PREFERRED_PROVIDER_virtual/update-alternatives = "${ATTO_IPK_UPDATE_ALTERNATIVES}"
VIRTUAL-RUNTIME_update-alternatives = "${ATTO_IPK_UPDATE_ALTERNATIVES}"
```

## conf/layer.conf
```bitbake
# We have a conf and classes directory, append to BBPATH
BBPATH .= ":${LAYERDIR}"

# We have a recipes directory, add to BBFILES
BBFILES += "${LAYERDIR}/recipes*/*/*.bb ${LAYERDIR}/recipes*/*/*.bbappend"

BBFILE_COLLECTIONS += "atto-layer"
BBFILE_PATTERN_atto-layer := "^${LAYERDIR}/"
BBFILE_PRIORITY_atto-layer = "7"

SIGGEN_EXCLUDERECIPES_ABISAFE += " \
        atto-feed-configs \
        "
```
